/dts-v1/;
/ {
 soc {
  apmixedsys: apmixedsys@1001e000 {
   compatible = "mediatek,mt7986-pll";
   #address-cells = <1>;
   #size-cells = <0>;
   reg = <0x1001e000 0x1000>;
   status = "okay";
  };
 };
};
