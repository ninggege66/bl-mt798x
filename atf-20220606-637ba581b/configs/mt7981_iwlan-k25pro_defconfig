## atf-20220606-637ba581b/configs/mt7981_iwlan-k25pro_defconfig
```kconfig
CONFIG_PLAT_MT7981=y
CONFIG_TARGET_ALL_NO_SEC_BOOT=y
CONFIG_FLASH_DEVICE_SPIM_NAND=y
CONFIG_BGA=y
CONFIG_DDR3_FREQ_1866=y
CONFIG_DRAM_SIZE_512=y
CONFIG_LOG_LEVEL_INFO=y
```
